## components/tianshu_mesh_core/Kconfig
```kconfig
menu "Tianshu Mesh Core"

    config TIANSHU_MESH_CORE_ENABLE
        bool "Enable Tianshu Mesh Core"
        default y
        help
            Enable the Tianshu Mesh Core component.

    config TIANSHU_MESH_MAX_NODES
        int "Maximum number of mesh nodes"
        default 32
        depends on TIANSHU_MESH_CORE_ENABLE
        help
            Maximum number of nodes in the mesh network.

    config TIANSHU_MESH_MAX_CONNECTIONS
        int "Maximum direct connections per node"
        default 8
        depends on TIANSHU_MESH_CORE_ENABLE
        help
            Maximum number of direct connections per node.

    config TIANSHU_HOST_ELECTION_ENABLE
        bool "Enable Host Election"
        default y
        depends on TIANSHU_MESH_CORE_ENABLE
        help
            Enable automatic host election functionality.

endmenu
```

## components/tianshu_web_service/Kconfig
```kconfig
menu "Tianshu Web Service"

    config TIANSHU_WEB_SERVICE_ENABLE
        bool "Enable Tianshu Web Service"
        default y
        help
            Enable the Tianshu Web Service component.

    config TIANSHU_WEB_SERVICE_PORT
        int "Web Server Port"
        default 80
        depends on TIANSHU_WEB_SERVICE_ENABLE
        help
            HTTP port for the web server.

    config TIANSHU_WEB_SERVICE_SPIFFS_ENABLE
        bool "Enable SPIFFS for static files"
        default y
        depends on TIANSHU_WEB_SERVICE_ENABLE
        help
            Enable SPIFFS to serve static web files.

endmenu
```

## main/Kconfig.projbuild
```kconfig
menu "Tianshu Board Configuration"

    choice BOARD_TYPE_CHOICE
        prompt "Board Type"
        default BOARD_TYPE_TIANSHU_MESH

        config BOARD_TYPE_TIANSHU_MESH
            bool "Tianshu Mesh (Standard)"

    endchoice

    config BOARD_NAME
        string "Board Name"
        default "tianshu-mesh"
        help
            Custom name for the board.

endmenu
```

## sdkconfig.defaults
```kconfig
CONFIG_IDF_TARGET="esp32c3"
CONFIG_ESPTOOLPY_FLASHSIZE_4MB=y
CONFIG_PARTITION_TABLE_CUSTOM=y
CONFIG_PARTITION_TABLE_CUSTOM_FILENAME="partitions/v1/4m.csv"

CONFIG_BT_ENABLED=y
CONFIG_BT_BLE_ENABLED=y
CONFIG_BLE_MESH_ENABLED=y
CONFIG_BLE_MESH_PROVISIONER=y
CONFIG_BLE_MESH_GATT_PROXY=y
CONFIG_BLE_MESH_RELAY=y
CONFIG_BLE_MESH_FRIEND=y

CONFIG_ESP_TASK_WDT_TIMEOUT_S=20

CONFIG_LWIP_SO_RCVBUF=65536
CONFIG_LWIP_SO_SNDBUF=65536
```

## sdkconfig.defaults.esp32
```kconfig
CONFIG_IDF_TARGET="esp32"
CONFIG_ESPTOOLPY_FLASHSIZE_8MB=y
CONFIG_PARTITION_TABLE_CUSTOM=y
CONFIG_PARTITION_TABLE_CUSTOM_FILENAME="partitions/v1/8m.csv"

CONFIG_BT_ENABLED=y
CONFIG_BT_BLE_ENABLED=y
CONFIG_BLE_MESH_ENABLED=y
CONFIG_BLE_MESH_PROVISIONER=y
CONFIG_BLE_MESH_GATT_PROXY=y
CONFIG_BLE_MESH_RELAY=y
CONFIG_BLE_MESH_FRIEND=y

CONFIG_WIFI_ENABLED=y
CONFIG_ESP_WIFI_STA_AUTO_CONNECT=y

CONFIG_ESP_TASK_WDT_TIMEOUT_S=20
```

## sdkconfig.defaults.esp32s3
```kconfig
CONFIG_IDF_TARGET="esp32s3"
CONFIG_ESPTOOLPY_FLASHSIZE_16MB=y
CONFIG_PARTITION_TABLE_CUSTOM=y
CONFIG_PARTITION_TABLE_CUSTOM_FILENAME="partitions/v1/16m.csv"

CONFIG_BT_ENABLED=y
CONFIG_BT_BLE_ENABLED=y
CONFIG_BLE_MESH_ENABLED=y
CONFIG_BLE_MESH_PROVISIONER=y
CONFIG_BLE_MESH_GATT_PROXY=y
CONFIG_BLE_MESH_RELAY=y
CONFIG_BLE_MESH_FRIEND=y

CONFIG_WIFI_ENABLED=y
CONFIG_ESP_WIFI_STA_AUTO_CONNECT=y

CONFIG_ESP_TASK_WDT_TIMEOUT_S=20
```
